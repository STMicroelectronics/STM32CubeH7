/*###ICF### Section handled by ICF editor, don't touch! ****/
/*-Editor annotation file-*/
/* IcfEditorFile="$TOOLKIT_DIR$\config\ide\IcfEditor\cortex_v1_0.xml" */
/*-Specials-*/
define symbol __ICFEDIT_intvec_start__ = __C_START_ADDR; /* 0x08000000 */
/*-Memory Regions-*/
define symbol __ICFEDIT_region_ROM_ML_start__     = 0x08000000;
define symbol __ICFEDIT_region_ROM_ML_end__       = 0x0803FFFF; /* 256 bytes for the Menu Launcher */
define symbol __ICFEDIT_region_ROM_STEW_start__   = 0x08040000;
define symbol __ICFEDIT_region_ROM_STEW_end__     = 0x0809FFFF; /* 384 Kbytes for STemWin demo */
define symbol __ICFEDIT_region_ROM_EWIZ_start__   = 0x080A0000;
define symbol __ICFEDIT_region_ROM_EWIZ_end__     = 0x080FFFFF; /* 384 Kbytes for EmbeddedWizard demo */
define symbol __ICFEDIT_region_ROM_STFW_start__   = 0x08100000;
define symbol __ICFEDIT_region_ROM_STFW_end__     = 0x0813FFFF; /* 256 Kbytes for CM4 Firmwares */
define symbol __ICFEDIT_region_ROM_TGFX_start__   = 0x08140000;
define symbol __ICFEDIT_region_ROM_TGFX_end__     = 0x081DFFFF; /* 640 Kbytes for TouchGFX demo */
define symbol __ICFEDIT_region_ROM_CUC_start__    = 0x081E0000;
define symbol __ICFEDIT_region_ROM_CUC_end__      = 0x081FFFFF; /* 128 Kbytes for CustUC demo */

/*-Internal RAM Memory Regions-*/
define symbol __ICFEDIT_region_ITCMRAM_start__    = 0x00000000;
define symbol __ICFEDIT_region_ITCMRAM_end__      = 0x0000FFFF; /*  64 Kbytes */
define symbol __ICFEDIT_region_DTCMRAM_start__    = 0x20000000;
define symbol __ICFEDIT_region_DTCMRAM_end__      = 0x2001FFFF; /* 128 Kbytes */
define symbol __ICFEDIT_region_RAM_start__        = 0x24000000;
define symbol __ICFEDIT_region_RAM_end__          = 0x2407FFFF; /* 512 Kbytes */

/*-External RAM Memory Regions-*/
define symbol __ICFEDIT_region_SDRAM1_start__     = 0xD0000000; /*   8 Mbytes */
define symbol __ICFEDIT_region_SDRAM1_end__       = 0xD07FFFFF;
define symbol __ICFEDIT_region_SDRAM2_start__     = 0xD0800000; /*   8 Mbytes */
define symbol __ICFEDIT_region_SDRAM2_end__       = 0xD0FFFFFF;
define symbol __ICFEDIT_region_SDRAM3_start__     = 0xD1000000; /*   8 Mbytes */
define symbol __ICFEDIT_region_SDRAM3_end__       = 0xD17FFFFF;
define symbol __ICFEDIT_region_SDRAM4_start__     = 0xD1800000; /*   8 Mbytes */
define symbol __ICFEDIT_region_SDRAM4_end__       = 0xD1FFFFFF;

/*-Quad-SPI Memory Regions-*/
define symbol __ICFEDIT_region_QSPI_ML_start__    = 0x90000000;
define symbol __ICFEDIT_region_QSPI_ML_end__      = 0x907FFFFF; /*  8 Mbytes for the MenuLauncher */
define symbol __ICFEDIT_region_QSPI_STEW_start__  = 0x90800000;
define symbol __ICFEDIT_region_QSPI_STEW_end__    = 0x925FFFFF; /* 30 Mbytes for STemWin demo */
define symbol __ICFEDIT_region_QSPI_EWIZ_start__  = 0x92600000;
define symbol __ICFEDIT_region_QSPI_EWIZ_end__    = 0x943FFFFF; /* 30 Mbytes for EmbeddedWizard demo */
define symbol __ICFEDIT_region_QSPI_TGFX_start__  = 0x94400000;
define symbol __ICFEDIT_region_QSPI_TGFX_end__    = 0x961FFFFF; /* 30 Mbytes for TouchGFX demo */
define symbol __ICFEDIT_region_QSPI_CUC_start__   = 0x96200000;
define symbol __ICFEDIT_region_QSPI_CUC_end__     = 0x97FFFFFF; /* 30 Mbytes for CustUC demo */

/*-Sizes-*/
define symbol __ICFEDIT_size_cstack__ = 0x2000;  /* 8 Kb */
define symbol __ICFEDIT_size_heap__   = 0x2000;  /* 8 Kb */
/**** End of ICF editor section. ###ICF###*/

define memory mem with size = 4G;
define region ROM_ML_region     = mem:[from __ICFEDIT_region_ROM_ML_start__     to __ICFEDIT_region_ROM_ML_end__];
define region ROM_STEW_region   = mem:[from __ICFEDIT_region_ROM_STEW_start__   to __ICFEDIT_region_ROM_STEW_end__];
define region ROM_CUC_region    = mem:[from __ICFEDIT_region_ROM_CUC_start__    to __ICFEDIT_region_ROM_CUC_end__];
define region ROM_STFW_region   = mem:[from __ICFEDIT_region_ROM_STFW_start__   to __ICFEDIT_region_ROM_STFW_end__];
define region ROM_TGFX_region   = mem:[from __ICFEDIT_region_ROM_TGFX_start__   to __ICFEDIT_region_ROM_TGFX_end__];
define region ROM_EWIZ_region   = mem:[from __ICFEDIT_region_ROM_EWIZ_start__   to __ICFEDIT_region_ROM_EWIZ_end__];

define region ITCMRAM_region    = mem:[from __ICFEDIT_region_ITCMRAM_start__    to __ICFEDIT_region_ITCMRAM_end__];
define region DTCMRAM_region    = mem:[from __ICFEDIT_region_DTCMRAM_start__    to __ICFEDIT_region_DTCMRAM_end__];
define region RAM_region        = mem:[from __ICFEDIT_region_RAM_start__        to __ICFEDIT_region_RAM_end__];
define region SDRAM1_region     = mem:[from __ICFEDIT_region_SDRAM1_start__     to __ICFEDIT_region_SDRAM1_end__];
define region SDRAM2_region     = mem:[from __ICFEDIT_region_SDRAM2_start__     to __ICFEDIT_region_SDRAM2_end__];
define region SDRAM3_region     = mem:[from __ICFEDIT_region_SDRAM3_start__     to __ICFEDIT_region_SDRAM3_end__];
define region SDRAM4_region     = mem:[from __ICFEDIT_region_SDRAM4_start__     to __ICFEDIT_region_SDRAM4_end__];

define region QSPI_ML_region    = mem:[from __ICFEDIT_region_QSPI_ML_start__    to __ICFEDIT_region_QSPI_ML_end__];
define region QSPI_STEW_region  = mem:[from __ICFEDIT_region_QSPI_STEW_start__  to __ICFEDIT_region_QSPI_STEW_end__];
define region QSPI_CUC_region   = mem:[from __ICFEDIT_region_QSPI_CUC_start__   to __ICFEDIT_region_QSPI_CUC_end__];
define region QSPI_TGFX_region  = mem:[from __ICFEDIT_region_QSPI_TGFX_start__  to __ICFEDIT_region_QSPI_TGFX_end__];
define region QSPI_EWIZ_region  = mem:[from __ICFEDIT_region_QSPI_EWIZ_start__  to __ICFEDIT_region_QSPI_EWIZ_end__];

define block CSTACK     with alignment = 8, size = __ICFEDIT_size_cstack__    { };
define block HEAP       with alignment = 8, size = __ICFEDIT_size_heap__      { };
define block DEMO_INFO  with alignment = 8, size = 0x800                      { first section DemoContextSection };
define block EXT_ROM    with alignment = 32                                   { first section ExtRamSection_init };
define overlay EXT_RAM  with alignment = 32                                   { first section ExtRamSection };
define block JPEG_BUFFERS with alignment = 32                                 { first section jpeg_decoder_buffers };
define block RGB_BUFFERS with alignment = 32                                  { first section rgb_video_buffers };

initialize by copy { readwrite };
initialize manually { readonly data section ExtRamSection };
do not initialize  { section .noinit, section framebuffer };
do not initialize  { section jpeg_decoder_buffers, section rgb_video_buffers };
do not initialize  { section layer0_fb0, section layer0_fb1, section layer0_fb2 };
do not initialize  { section layer1_fb0, section layer1_fb1, section layer1_fb2 };

place at address mem:__ICFEDIT_intvec_start__ { readonly section .intvec };
place at end of ROM_ML_region { block DEMO_INFO };

place in ROM_ML_region      { first section flasher_code_section, readonly };
place in ITCMRAM_region     { };
place in DTCMRAM_region     { first block CSTACK, block HEAP, last readwrite };
place in RAM_region         { first section heap_mem, section STemWinMemPool, last section sdio_heap };
place in SDRAM1_region      { first section layer0_fb0, section layer1_fb0 };
place in SDRAM2_region      { first section layer0_fb1, section layer1_fb1 };
place in SDRAM3_region      { first section layer0_fb2, section layer1_fb2, last block JPEG_BUFFERS };
place in SDRAM4_region      { first overlay EXT_RAM, last block RGB_BUFFERS };

place in QSPI_CUC_region    { first section splash_st_section };
place in QSPI_ML_region     { first section default_icon_section
                            , section default_logo_section
                            , section ExtFlashSection
                            , last block EXT_ROM };
/*
place in QSPI_ML_region     { readonly data object LucidaSans18.o
                            , readonly data object LucidaSans25.o
                            , readonly data object LucidaSans30.o
                            , readonly data object F13_1.o
                            , readonly data object F13_ASCII.o
                            , readonly data object F20_ASCII.o
                            , readonly data object F24B_ASCII.o
                            , readonly data object F32B_ASCII.o
                            , readonly data object F6x8.o };
*/