/*###ICF### Section handled by ICF editor, don't touch! ****/
/*-Editor annotation file-*/
/* IcfEditorFile="$TOOLKIT_DIR$\config\ide\IcfEditor\cortex_v1_0.xml" */
/*-Specials-*/
define symbol __ICFEDIT_intvec_start__ = __C_START_ADDR; /* 0x08140000 */
/*-Memory Regions-*/
define symbol __ICFEDIT_region_ROM_start__        = 0x08000000;
define symbol __ICFEDIT_region_ROM_end__          = 0x081FFFFF; /* 2 Mbytes */
define symbol __ICFEDIT_region_ROM_ML_start__     = 0x08000000;
define symbol __ICFEDIT_region_ROM_ML_end__       = 0x0803FFFF; /* 256 bytes for the Menu Launcher */
define symbol __ICFEDIT_region_ROM_STEW_start__   = 0x08040000;
define symbol __ICFEDIT_region_ROM_STEW_end__     = 0x080FFFFF; /* 384 Kbytes for STemWin demo */
define symbol __ICFEDIT_region_ROM_EWIZ_start__   = 0x080A0000;
define symbol __ICFEDIT_region_ROM_EWIZ_end__     = 0x080FFFFF; /* 384 Kbytes for CustUC demo */
define symbol __ICFEDIT_region_ROM_FW_start__     = 0x08100000;
define symbol __ICFEDIT_region_ROM_FW_end__       = 0x0813FFFF; /* 256 Kbytes for CM4 Firmwares */
define symbol __ICFEDIT_region_ROM_TGFX_start__   = 0x08140000;
define symbol __ICFEDIT_region_ROM_TGFX_end__     = 0x081DFFFF; /* 640 Kbytes for TouchGFX demo */
define symbol __ICFEDIT_region_ROM_CUC_start__    = 0x081E0000;
define symbol __ICFEDIT_region_ROM_CUC_end__      = 0x081FFFFF; /* 128 Kbytes for EmbeddedWizard demo */

/*-Internal RAM Memory Regions-*/
define symbol __ICFEDIT_region_ITCMRAM_start__    = 0x00000000;
define symbol __ICFEDIT_region_ITCMRAM_end__      = 0x0000FFFF; /*  64 Kbytes */
define symbol __ICFEDIT_region_DTCMRAM_start__    = 0x20000000;
define symbol __ICFEDIT_region_DTCMRAM_end__      = 0x2001FFFF; /* 128 Kbytes */
define symbol __ICFEDIT_region_RAM_start__        = 0x24000000; /* 512 Kbytes */
define symbol __ICFEDIT_region_RAM_end__          = 0x2407FFFF;
define symbol __ICFEDIT_region_SDRAM_start__      = 0xD0000000; /*  32 Mbytes */
define symbol __ICFEDIT_region_SDRAM_end__        = 0xD1FFFFFF;

/*-Quad-SPI Memory Regions-*/
define symbol __ICFEDIT_region_QSPI_ML_start__    = 0x90000000;
define symbol __ICFEDIT_region_QSPI_ML_end__      = 0x907FFFFF; /*  8 Mbytes for the MenuLauncher */
define symbol __ICFEDIT_region_QSPI_STEW_start__  = 0x90800000;
define symbol __ICFEDIT_region_QSPI_STEW_end__    = 0x925FFFFF; /* 30 Mbytes for STemWin demo */
define symbol __ICFEDIT_region_QSPI_CUC_start__   = 0x92600000;
define symbol __ICFEDIT_region_QSPI_CUC_end__     = 0x943FFFFF; /* 30 Mbytes for STemWin demo */
define symbol __ICFEDIT_region_QSPI_TGFX_start__  = 0x94400000;
define symbol __ICFEDIT_region_QSPI_TGFX_end__    = 0x961FFFFF; /* 30 Mbytes for TouchGFX demo */
define symbol __ICFEDIT_region_QSPI_EWIZ_start__  = 0x96200000;
define symbol __ICFEDIT_region_QSPI_EWIZ_end__    = 0x97FFFFFF; /* 30 Mbytes for EmbeddedWizard demo */

/*-Sizes-*/
define symbol __ICFEDIT_size_cstack__ = 0x1000; /* 2 Kb */
define symbol __ICFEDIT_size_heap__   = 0xC000;  /* 2 Kb */
/**** End of ICF editor section. ###ICF###*/

define memory mem with size = 4G;
define region ROM_region        = mem:[from __ICFEDIT_region_ROM_start__        to __ICFEDIT_region_ROM_ML_end__];
define region ROM_ML_region     = mem:[from __ICFEDIT_region_ROM_ML_start__     to __ICFEDIT_region_ROM_ML_end__];
define region ROM_STEW_region   = mem:[from __ICFEDIT_region_ROM_STEW_start__   to __ICFEDIT_region_ROM_STEW_end__];
define region ROM_CUC_region    = mem:[from __ICFEDIT_region_ROM_CUC_start__    to __ICFEDIT_region_ROM_CUC_end__];
define region ROM_TGFX_region   = mem:[from __ICFEDIT_region_ROM_TGFX_start__   to __ICFEDIT_region_ROM_TGFX_end__];
define region ROM_EWIZ_region   = mem:[from __ICFEDIT_region_ROM_EWIZ_start__   to __ICFEDIT_region_ROM_EWIZ_end__];

define region ITCMRAM_region    = mem:[from __ICFEDIT_region_ITCMRAM_start__    to __ICFEDIT_region_ITCMRAM_end__];
define region DTCMRAM_region    = mem:[from __ICFEDIT_region_DTCMRAM_start__    to __ICFEDIT_region_DTCMRAM_end__];
define region RAM_region        = mem:[from __ICFEDIT_region_RAM_start__        to __ICFEDIT_region_RAM_end__];
define region SDRAM_region      = mem:[from __ICFEDIT_region_SDRAM_start__      to __ICFEDIT_region_SDRAM_end__];

define region QSPI_ML_region    = mem:[from __ICFEDIT_region_QSPI_ML_start__    to __ICFEDIT_region_QSPI_ML_end__];
define region QSPI_STEW_region  = mem:[from __ICFEDIT_region_QSPI_STEW_start__  to __ICFEDIT_region_QSPI_STEW_end__];
define region QSPI_CUC_region   = mem:[from __ICFEDIT_region_QSPI_CUC_start__   to __ICFEDIT_region_QSPI_CUC_end__];
define region QSPI_TGFX_region  = mem:[from __ICFEDIT_region_QSPI_TGFX_start__  to __ICFEDIT_region_QSPI_TGFX_end__];
define region QSPI_EWIZ_region  = mem:[from __ICFEDIT_region_QSPI_EWIZ_start__  to __ICFEDIT_region_QSPI_EWIZ_end__];

define block CSTACK       with alignment = 8, size = __ICFEDIT_size_cstack__    { };
define block HEAP         with alignment = 8, size = __ICFEDIT_size_heap__      { };

define block OS_HEAP      with alignment = 32   { first section heap_mem };                 /* 64 Kb */
define block FRAME_BUF    with alignment = 32   { first section framebuffer };
define block GFX_BUFFERS  with alignment = 256  { first section gfx_buffers };              /* 10 Mbytes */
define block AUD_BUFFERS  with alignment = 32   { first section audio_buffers };
define block VIZ_BUFFERS  with alignment = 32   { first section viz_front_buffer, section viz_back_buffer, section viz_deform_x_buffer, section viz_deform_y_buffer, section viz_bitmap_buffer };
define block AVI_BUFFERS  with alignment = 32   { first section avi_video_buffers, section avi_audio_buffers };
define block MPEG_BUFFERS with alignment = 32   { first section jpeg_decoder_buffers };
define block RGB_BUFFERS  with alignment = 32   { first section rgb_video_buffers };        /* 2 * (800 * 480 * 2 bytes) : 1500 Kb */

/*-Third Party Demonstration Headers-*/
define symbol __thp_int_header_start__ = __ICFEDIT_region_ROM_TGFX_start__ + 0x1000;
define symbol __thp_ext_header_start__ = __ICFEDIT_region_QSPI_TGFX_start__;

initialize by copy { readwrite };
do not initialize  { section .noinit, section framebuffer, section rgb_video_buffers, section gfx_buffers };
do not initialize  { section viz_front_buffer, section viz_back_buffer, section viz_deform_x_buffer, section viz_deform_y_buffer, section viz_bitmap_buffer };

place at address mem:__ICFEDIT_intvec_start__ { readonly section .intvec };

/*-Third Party headers Memory Placement-*/
place at address mem:__thp_int_header_start__   { readonly section IntThirdPartyHeaderSection };
place at address mem:__thp_ext_header_start__   { readonly section ExtThirdPartyHeaderSection, readonly section demo_icon_section, readonly section demo_logo_section };

place in DTCMRAM_region     { };
place in RAM_region         { first block CSTACK, block HEAP, block OS_HEAP, block AUD_BUFFERS, block AVI_BUFFERS, block MPEG_BUFFERS, last section sdio_heap, readwrite };
place in SDRAM_region       { first block FRAME_BUF, block VIZ_BUFFERS, block RGB_BUFFERS, last block GFX_BUFFERS };
place in ROM_TGFX_region    { readonly };
place in QSPI_TGFX_region   { section ExtFlashSection };
